/dts-v1/;
/plugin/;

/ {
	compatible = "brcm,bcm2835";

	fragment@0 {
		target = <&i2c1>;
		__overlay__ {
			status = "okay";
			#address-cells = <1>;
			#size-cells = <0>;
			spennylcd@27 {
				compatible = "spenny,spennylcd";
				reg = <0x27>;
			};
		};
	};
};
